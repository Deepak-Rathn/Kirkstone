## kirkstone/meta-rdk-sampleapp/conf/layer.conf
```bitbake
# Append conf and classes dir to BBPATH so BitBake can find layer config and classes
BBPATH .= ":${LAYERDIR}"
BBPATH .= ":${LAYERDIR}/classes"

# Add recipe patterns for this layer
BBFILES += "\
    ${LAYERDIR}/recipes-*/*/*.bb \
    ${LAYERDIR}/recipes-*/*/*/*.bb \
    ${LAYERDIR}/recipes-*/*/*.bbappend \
    ${LAYERDIR}/recipes-*/*/*/*.bbappend \
"

# Register this layer collection and its priority
BBFILE_COLLECTIONS += "rdk-sampleapp"
BBFILE_PATTERN_rdk-sampleapp := "^${LAYERDIR}/"
BBFILE_PRIORITY_rdk-sampleapp = "7"

# Series compatibility
LAYERSERIES_COMPAT_rdk-sampleapp = "kirkstone"

# Optional: declare dependencies on other layers if needed
# For a generic sample we do not mandate dependencies, but many RDK-B layers depend on 'rdk'
# Uncomment the following if your sample requires 'rdk' common classes/macros
# LAYERDEPENDS_rdk-sampleapp = "rdk"

# Additional license dirs if needed
LICENSE_PATH += "${LAYERDIR}"

# End of layer.conf
```
